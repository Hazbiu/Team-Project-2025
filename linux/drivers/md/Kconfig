## linux/drivers/md/Kconfig
```kconfig
# SPDX-License-Identifier: GPL-2.0-only
#
# Block device driver configuration
#

menuconfig MD
	bool "Multiple devices driver support (RAID and LVM)"
	depends on BLOCK
	help
	  Support multiple physical spindles through a single logical device.
	  Required for RAID and logical volume management.

if MD

config BLK_DEV_MD
	tristate "RAID support"
	select BLOCK_HOLDER_DEPRECATED if SYSFS
	select BUFFER_HEAD
	select BLOCK_LEGACY_AUTOLOAD
	help
	  This driver lets you combine several hard disk partitions into one
	  logical block device. This can be used to simply append one
	  partition to another one or to combine several redundant hard disks
	  into a RAID1/4/5 device so as to provide protection against hard
	  disk failures. This is called "Software RAID".

	  If unsure, say N.

config MD_BITMAP
	bool "MD RAID bitmap support"
	default y
	depends on BLK_DEV_MD
	help
	  Enables write-intent bitmap support for faster resyncs.

config MD_LLBITMAP
	bool "MD RAID lockless bitmap support"
	depends on BLK_DEV_MD
	help
	  Enables experimental lockless bitmap support.

config MD_AUTODETECT
	bool "Autodetect RAID arrays during kernel boot"
	depends on BLK_DEV_MD=y
	default y
	help
	  Automatically detect RAID arrays during kernel boot.

config MD_BITMAP_FILE
	bool "MD bitmap file support (deprecated)"
	default y
	depends on MD_BITMAP

config MD_LINEAR
	tristate "Linear (append) mode"
	depends on BLK_DEV_MD

config MD_RAID0
	tristate "RAID-0 (striping) mode"
	depends on BLK_DEV_MD

config MD_RAID1
	tristate "RAID-1 (mirroring) mode"
	depends on BLK_DEV_MD

config MD_RAID10
	tristate "RAID-10 (mirrored striping) mode"
	depends on BLK_DEV_MD

config MD_RAID456
	tristate "RAID-4/RAID-5/RAID-6 mode"
	depends on BLK_DEV_MD
	select RAID6_PQ
	select CRC32

config MD_CLUSTER
	tristate "Cluster Support for MD"
	select MD_BITMAP
	depends on BLK_DEV_MD
	depends on DLM
	default n

source "drivers/md/bcache/Kconfig"

config BLK_DEV_DM_BUILTIN
	bool

config BLK_DEV_DM
	tristate "Device mapper support"
	select BLOCK_HOLDER_DEPRECATED if SYSFS
	select BLK_DEV_DM_BUILTIN
	select BLK_MQ_STACKING
	depends on DAX || DAX=n

config DM_DEBUG
	bool "Device mapper debugging support"
	depends on BLK_DEV_DM

config DM_BUFIO
	tristate
	depends on BLK_DEV_DM

config DM_BIO_PRISON
	tristate
	depends on BLK_DEV_DM

source "drivers/md/persistent-data/Kconfig"

config DM_UNSTRIPED
	tristate "Unstriped target"
	depends on BLK_DEV_DM

config DM_CRYPT
	tristate "Crypt target support"
	depends on BLK_DEV_DM
	select CRYPTO
	select CRYPTO_CBC
	select CRYPTO_ESSIV

config DM_SNAPSHOT
	tristate "Snapshot target"
	depends on BLK_DEV_DM
	select DM_BUFIO

config DM_THIN_PROVISIONING
	tristate "Thin provisioning target"
	depends on BLK_DEV_DM
	select DM_PERSISTENT_DATA
	select DM_BIO_PRISON

config DM_CACHE
	tristate "Cache target (EXPERIMENTAL)"
	depends on BLK_DEV_DM
	select DM_PERSISTENT_DATA
	select DM_BIO_PRISON

config DM_CACHE_SMQ
	tristate "Stochastic MQ Cache Policy (EXPERIMENTAL)"
	depends on DM_CACHE
	default y

config DM_WRITECACHE
	tristate "Writecache target"
	depends on BLK_DEV_DM

config DM_EBS
	tristate "Emulated block size target (EXPERIMENTAL)"
	depends on BLK_DEV_DM && !HIGHMEM
	select DM_BUFIO

config DM_ERA
	tristate "Era target (EXPERIMENTAL)"
	depends on BLK_DEV_DM
	select DM_PERSISTENT_DATA
	select DM_BIO_PRISON

config DM_CLONE
	tristate "Clone target (EXPERIMENTAL)"
	depends on BLK_DEV_DM
	select DM_PERSISTENT_DATA

config DM_MIRROR
	tristate "Mirror target"
	depends on BLK_DEV_DM

config DM_LOG_USERSPACE
	tristate "Mirror userspace logging"
	depends on DM_MIRROR && NET
	select CONNECTOR

config DM_RAID
	tristate "RAID 1/4/5/6/10 target"
	depends on BLK_DEV_DM
	select MD_RAID0
	select MD_RAID1
	select MD_RAID10
	select MD_RAID456
	select MD_BITMAP
	select BLK_DEV_MD

config DM_ZERO
	tristate "Zero target"
	depends on BLK_DEV_DM

config DM_MULTIPATH
	tristate "Multipath target"
	depends on BLK_DEV_DM

config DM_DELAY
	tristate "I/O delaying target"
	depends on BLK_DEV_DM

config DM_DUST
	tristate "Bad sector simulation target"
	depends on BLK_DEV_DM

config DM_INIT
	bool "DM \"dm-mod.create=\" parameter support"
	depends on BLK_DEV_DM=y
	help
	  Enable dm-mod.create= parameter to create mapped devices at init time.

config DM_UEVENT
	bool "DM uevents"
	depends on BLK_DEV_DM

config DM_FLAKEY
	tristate "Flakey target"
	depends on BLK_DEV_DM

config DM_VERITY
	tristate "Verity target support"
	depends on BLK_DEV_DM
	select CRYPTO
	select CRYPTO_HASH
	select DM_BUFIO

config DM_VERITY_AUTOBOOT
	bool "Device Mapper Verity Auto-Boot Setup"
	depends on DM_VERITY
	help
	  Enable automatic in-kernel setup of dm-verity root device
	  to allow booting without an initramfs.

config DM_VERITY_VERIFY_ROOTHASH_SIG
	bool "Verity data device root hash signature verification support"
	depends on DM_VERITY

config DM_VERITY_FEC
	bool "Verity forward error correction support"
	depends on DM_VERITY
	select REED_SOLOMON
	select REED_SOLOMON_DEC8

config DM_VERITY_SIGNED
	tristate "dm-verity target with signed metadata (verity-signed)"
	depends on DM_VERITY && KEYS && PKCS7_MESSAGE_PARSER && X509_CERTIFICATE_PARSER && ASYMMETRIC_KEY_TYPE
	select DM_INIT
	help
	  This option adds a new Device Mapper target called "verity-signed".
	  It verifies signed dm-verity metadata during early boot.

# --- ✅ Your custom option below ---

config DM_VERITY_AUTObOOT
	bool "DM-Verity autoboot (create verified_root at boot)"
	depends on BLK_DEV_DM && DM_INIT
	default y
	help
	  Automatically create a verified_root device during early boot.
	  This enables dm-verity-autoboot support when using
	  dm.verity.autoboot= in the kernel command line.

# --- ✅ End of custom option ---

config DM_ZONED
	tristate "Drive-managed zoned block device target support"
	depends on BLK_DEV_DM
	depends on BLK_DEV_ZONED
	select CRC32

config DM_AUDIT
	bool "DM audit events"
	depends on BLK_DEV_DM
	depends on AUDIT

source "drivers/md/dm-vdo/Kconfig"
source "drivers/md/dm-pcache/Kconfig"

endif # MD
```
